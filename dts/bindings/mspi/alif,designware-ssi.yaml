## dts/bindings/mspi/alif,designware-ssi.yaml
```yaml
# Copyright (c) 2026 Alif Semiconductor
# SPDX-License-Identifier: Apache-2.0

description: Alif wrapper for Synopsys DesignWare Synchronous Serial Interface

compatible: "alif,designware-ssi"

include: "snps,designware-ssi.yaml"

properties:
  aes-reg:
    type: array
    required: true
    description: Register space used by the Alif AES wrapper on top of SSI.

  ddr-drive-edge:
    type: int
    default: 1
    description: TXD drive edge setting for DDR operation.

  rx-ds-delay:
    type: int
    default: 16
    description: Receive data strobe delay.

  baud2-delay:
    type: int
    default: 2
    enum:
      - 0
      - 1
      - 2
    description: BAUD2 delay control used by the Alif OSPI/MSPI wrapper.

  xip-wait-cycles:
    type: int
    default: 16
    description: Wait cycles for XiP transactions.

  xip-rxds-vl-en:
    type: boolean
    description: Enable RXDS variable latency on XiP transactions.

  xip-base-address:
    type: array
    description: XiP memory address range.

  memmap-write-support:
    type: boolean
    description: Controller supports memory-mapped write/XiP write registers.
```

## dts/bindings/mtd/alif,infinieon-s80ks2564.yaml
```yaml
# Copyright (c) 2026 Alif Semiconductor
#
# SPDX-License-Identifier: Apache-2.0

description: Infineon S80KS2564 HyperRAM on ALIF Hex-SPI(DW-SSI) bus

compatible: "alif,infineon-s80ks2564"

include: base.yaml

properties:
  size:
    type: int
    description: |
      The RAM size in bits.

  latency:
    type: int
    description: |
      The RAM wait cycle.

  rxd-signal-delay:
    type: int
    description: |
      RXD signal delay value tunable for high-speed transactions.

  reset-gpios:
    type: phandle-array
    description: |
      The RESETn pin to be toggled to reset memory.
```

## dts/bindings/mtd/apmemory,aps512xxn-mspi.yaml
```yaml
# Copyright (c) 2026 Alif Semiconductor
# SPDX-License-Identifier: Apache-2.0

description: AP Memory APS512XXN Octal DDR pSRAM on an MSPI bus

compatible: "apmemory,aps512xxn"

include: mspi-device.yaml

properties:
  size:
    type: int
    required: true
    description: Memory size in bytes.

  latency-code:
    type: int
    required: true
    enum: [3, 4, 5, 6, 7]
    description: |
      APS512XXN read latency code. Select a value supported at the
      configured MSPI frequency: 3 up to 66 MHz, 4 up to 109 MHz,
      5 up to 133 MHz, 6 up to 166 MHz, or 7 up to 200 MHz.
```

## dts/bindings/mtd/mxicy,mx66uw-mspi.yaml
```yaml
# Copyright (C) 2026 Alif Semiconductor.
# SPDX-License-Identifier: Apache-2.0

description: Macronix MX66UW flash on an MSPI bus

compatible: "mxicy,mx66uw-mspi"

include: [mspi-device.yaml, "jedec,jesd216.yaml"]

properties:
  write-block-size:
    type: int
    description: Minimum write size supported by the flash device

  reset-gpios:
    type: phandle-array
    description: RESET line used to reset the flash during initialization

  t-reset-pulse:
    type: int
    description: Minimum active RESET pulse duration in microseconds

  t-reset-recovery:
    type: int
    description: Flash recovery time after RESET in microseconds
```

## samples/subsys/usb/uac2_explicit_feedback/boards/alif_b1_dk_ab1c1f4m51820ph0_rtss_he.conf
```kconfig
CONFIG_I2C=y
CONFIG_WM8904=y
CONFIG_AUDIO=y
CONFIG_AUDIO_CODEC=y

CONFIG_MAIN_STACK_SIZE=16384
CONFIG_ISR_STACK_SIZE=16384
CONFIG_PRIVILEGED_STACK_SIZE=4096
CONFIG_IDLE_STACK_SIZE=4096
CONFIG_SYSTEM_WORKQUEUE_STACK_SIZE=2048
CONFIG_UDC_DWC3_STACK_SIZE=4096
CONFIG_USBD_THREAD_STACK_SIZE=4096
```

## drivers/usb/udc/Kconfig.dwc3
```kconfig
# Copyright (c) 2025 Alifsemiconductor
# SPDX-License-Identifier: Apache-2.0

config UDC_DWC3
	bool "DWC3 USB device controller driver"
	default y
	depends on DT_HAS_SNPS_DWC3_ENABLED
	help
	  DWC3 USB device controller driver.

config UDC_DWC3_DMA
	bool "DWC3 USB DMA support"
	default y
	depends on UDC_DWC3
	help
	  Enable Buffer DMA if DWC3 USB controller supports Internal DMA.

config UDC_DWC3_HIBERNATION
	bool "DWC3 USB Hibernation support"
	default y
	depends on UDC_DWC3
	help
	  Enable Hibernation if DWC3 USB controller supports hibernation.

config UDC_DWC3_STACK_SIZE
	int "UDC DWC3 driver internal thread stack size"
	depends on UDC_DWC3
	default 2048
	help
	  DWC3 driver internal thread stack size.

config UDC_DWC3_THREAD_PRIORITY
	int "UDC DWC3 driver thread priority"
	depends on UDC_DWC3
	default 8
	help
	  DWC3 driver thread priority.
	  
config UDC_DWC3_MAX_QMESSAGES
	int "DWC3 UDC driver maximum number of ISR event messages"
	range 4 64
	default 16
	help
	  Maximum number of messages for handling of DWC3 USBD ISR events.
```

## dts/bindings/mspi/snps,designware-ssi.yaml
```yaml
# Copyright (c) 2024 Nordic Semiconductor ASA
# SPDX-License-Identifier: Apache-2.0

description: Synopsys DesignWare Synchronous Serial Interface (SSI) node

compatible: "snps,designware-ssi"

include: [mspi-controller.yaml, pinctrl-device.yaml]

properties:
  reg:
    required: true

  interrupts:
    required: true

  aes-reg:
    type: array
    required: true
    description: Register space used by the Alif AES wrapper on top of SSI.

  bus-speed:
    type: int
    required: true
    description: Operating bus speed in Hz used by the flash device.

  cs-pin:
    type: int
    required: true
    description: Hardware chip-select index used by the attached flash device.

  ddr-drive-edge:
    type: int
    default: 1
    description: TXD drive edge setting for DDR operation.

  rx-ds-delay:
    type: int
    default: 16
    description: Receive data strobe delay.

  baud2-delay:
    type: int
    default: 2
    enum:
      - 0
      - 1
      - 2
    description: BAUD2 delay control used by the Alif OSPI/MSPI wrapper.

  tx-fifo-threshold:
    type: int
    description: Transmit FIFO threshold.

  xip-wait-cycles:
    type: int
    default: 16
    description: Wait cycles for XiP transactions.

  xip-rxds-vl-en:
    type: boolean
    description: Enable RXDS variable latency on XiP transactions.

  xip-base-address:
    type: array
    description: XiP memory address range.

  packet-data-limit:
    required: true
    type: int
    const: 65536

  aux-reg-enable:
    type: boolean
    description: |
      Activates auxiliary register access that is needed on some platforms.

  fifo-depth:
    required: true
    type: int
    description: |
      Number of items that can be stored in the TX FIFO. Range: 8-256.
      If the RX FIFO depth is not specified separately in the rx-fifo-depth
      property, this value specifies depth of both TX and RX FIFOs.

  rx-fifo-depth:
    type: int
    description: |
      Number of items that can be stored in the RX FIFO. Range: 8-256.

  tx-fifo-threshold:
    type: int
    description: |
      Number of entries in the TX FIFO above which the TX transfer is started.
      Maximum value is the TX FIFO depth - 1.

  rx-fifo-threshold:
    type: int
    description: |
      Number of entries in the RX FIFO above which the controller gets an RX
      interrupt. Maximum value is the RX FIFO depth - 1.

  dma-transmit-data-level:
    type: int
    description: |
      When in DMA mode, the transmit data level field controls the level at
      which a DMA request is made by the transmit logic. A request to transmit
      is generated when the number of valid data entries in the transmit FIFO
      is equal to or below this field value.
      Lower values mean less frequent DMA triggers with larger bursts. Higher
      values mean fewer, smaller bursts (lower latency, higher overhead).
      Range: 0-15

  dma-receive-data-level:
    type: int
    description: |
      When in DMA mode, the receive data level field controls the level at
      which a DMA request is made by the receive logic. A request to receive
      is generated when the number of valid data entries in the receive FIFO
      is greater than this value.
      Lower values mean more frequent DMA triggers and higher values mean
      larger less frequent bursts. Range: 0-15
```
